## RPI/conf/bblayers.conf
```bitbake
# POKY_BBLAYERS_CONF_VERSION is increased each time build/conf/bblayers.conf
# changes incompatibly
POKY_BBLAYERS_CONF_VERSION = "2"

BBPATH = "${TOPDIR}"
BBFILES ?= ""

BBLAYERS ?= " \
  /home/hesham/poky/meta \
  /home/hesham/poky/meta-poky \
  /home/hesham/poky/meta-yocto-bsp \
  /home/hesham/poky/meta-raspberrypi \
  /home/hesham/poky/meta-openembedded/meta-oe \
  /home/hesham/poky/meta-openembedded/meta-python \
  /home/hesham/poky/meta-openembedded/meta-multimedia \
  /home/hesham/poky/meta-Sova \
  /home/hesham/poky/meta-openembedded/meta-networking \
  "
```

## meta-Sova/conf/layer.conf
```bitbake
# We have a conf and classes directory, add to BBPATH
BBPATH .= ":${LAYERDIR}"

# We have recipes-* directories, add to BBFILES
BBFILES += "${LAYERDIR}/recipes-*/*/*.bb \
            ${LAYERDIR}/recipes-*/*/*.bbappend"

BBFILE_COLLECTIONS += "meta-Sova"
BBFILE_PATTERN_meta-Sova = "^${LAYERDIR}/"
BBFILE_PRIORITY_meta-Sova = "6"

LAYERDEPENDS_meta-Sova = "core"
LAYERSERIES_COMPAT_meta-Sova = "mickledore"
```
